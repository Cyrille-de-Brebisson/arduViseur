#include "mainwindow.h"

#include <QApplication>
#include <QLAbel>
#include <QGridLayout>
#include <QTimer>
#include <QPainter>
#include <QDebug>
#include <QTime>

#include "../stardisp.h"

uint32_t getNow() { return QTime::currentTime().msecsSinceStartOfDay(); }

void saveData(uint8_t *d, int size)
{
    QFile f("settings"); f.open(QIODevice::WriteOnly); f.write((char*)d, size);
}
bool loadData(uint8_t *d, int size)
{
    QFile f("settings"); f.open(QIODevice::ReadOnly); 
    return f.read((char*)d, size)==size;
}

CArduViseur *arduViseur;
static int32_t const screenW= 320;
static int32_t const screenH= 240;
static int32_t const screenZoom= 2;
QImage im(screenW, screenH, QImage::Format_RGB16);
bool mouseDown= false;
int32_t mouseX, mouseY;
bool readTP(int32_t &x, int32_t &y)     // return false if up, else returns true and x/y
{
    if (!mouseDown) return false;
    x= mouseX; y= mouseY;
    return true;
}
static int32_t backLight= 50;
int32_t setBackLight(int32_t v) { if (v>=0) backLight= v; return backLight; }                    // v from 0 to 100. if <0, returns current back light
TPixel *getFB(int32_t &w, int32_t &h) // returns framebuffer location and size
{
    w= screenW; h= screenH; return (TPixel*)im.bits();
}
static uint8_t const cam[]={
    0x1B,0x3A,0x38,0x39,0x3A,0x3B,0x3B,0x3B,0x3B,0x3B,0x3A,0x3B,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0x0D,
    0x19,0x39,0x39,0x39,0x39,0x3A,0x3A,0x3A,0x3B,0x3B,0x3A,0x3B,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0x0D,
    0x1A,0x3B,0x39,0x3A,0x3A,0x3A,0x3B,0x3B,0x3C,0x3B,0x3B,0x3D,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0x0D,
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    0x18,0x36,0x36,0x36,0x36,0x37,0x38,0x39,0x39,0x3A,0x3B,0x3B,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0x2F,
};
bool getCamera(uint8_t *&buf, int32_t &w, int32_t &h)    // reads the camera data and get the size. if buf==nullptr, will allocate a new one!
{
    w= 160, h= 120;
    if (buf==nullptr) buf= (uint8_t*)malloc(w*h);
    memcpy(buf, cam, w*h);
    return true;
}
uint32_t getButtons() { return 0; }

void Widget::paintEvent(QPaintEvent *event)
{
    arduViseur->tick();
    QPainter painter;
    painter.begin(this);
    painter.drawImage(QRect(0, 0, screenW*screenZoom, screenH*screenZoom), im);
    painter.end();
}

static int32_t startConvert(char const *inFile, char const *outFile);
static void generateStarPatern();

//struct { char tpe[3]; int mag; float sze; float dst; int ra, dec; char name[30]; } cadwell[109]={
//    { "Oc" ,8,14,4800,1515,21845,""},
//    { "Pl" ,12,0.6,3500,443,18568,"Bow Tie Nebula"},
//    { "Sb" ,10,15,7000000,25146,17783,""},
//    { "Bn" ,7,18,1400,43069,17459,"Iris Nebula"},
//    { "Sp" ,9,18,13000000,7741,17433,""},
//    { "Pl" ,9,1,3000,36816,17058,"Cat's Eye Nebula"},
//    { "Sp" ,9,15,14000000,15595,16793,""},
//    { "Oc" ,10,4,3700,3054,16204,""},
//    { "Bn" ,8,20,2800,46994,16029,"Cave Nebula"},
//    { "Oc" ,7,16,7200,3618,15680,""},
//    { "Bn" ,7,10,7100,47810,15667,"Bubble nebula"},
//    { "Sp" ,10,10,18000000,42147,15398,""},
//    { "Oc" ,6,13,7922,2699,14933,"Owl or E.T. Cluster"},
//    { "Oc" ,4,30,7300,4778,14626,"Double Cluster"},
//    { "Pl" ,10,1,2200,40441,12932,"Blinking Planetary"},
//    { "Oc" ,6,21,2500,45578,12770,""},
//    { "El" ,9,10,2300000,1133,12416,""},
//    { "El" ,9,10,2300000,1331,12373,""},
//    { "Bn" ,10,12,3300,44834,12100,"Cocoon Nebula"},
//    { "Bn" ,6,100,1800,42967,11349,"North America Nebula"},
//    { "Ir" ,9,4,10000000,25538,11289,""},
//    { "Pl" ,9,0.5,3200,47988,10892,"Blue Snowball"},
//    { "Sb" ,10,5,31000000,4867,10841,""},
//    { "Sx" ,12,2,230000000,6819,10628,"Perseus A"},
//    { "Gc" ,10,4.1,275000,15636,9954,""},
//    { "Sp" ,11,5,10000000,25173,9681,""},
//    { "Bn" ,8,15,4700,41369,9817,"Crescent Nebula"},
//    { "Oc" ,6,50,1200,4020,9646,""},
//    { "Sb" ,10,3,69000000,26996,9484,""},
//    { "Sb" ,10,5,47000000,46322,8810,""},
//    { "Bn" ,6,25,1600,10792,8772,"Flaming Star Nebula"},
//    { "Sp" ,9,6,22000000,26013,8328,"Whale Galaxy"},
//    { "Sn" ,0,30,2500,42885,8119,"East Veil Nebula"},
//    { "Sn" ,0,30,2500,42519,7863,"West Veil Nebula"},
//    { "El" ,11,3,300000,26627,7163,""},
//    { "Sp" ,10,5,32000000,25804,7159,""},
//    { "Oc" ,6,7,1950,41369,6779,""},
//    { "Sb" ,10,10,32000000,25815,6651,"Needle Galaxy"},
//    { "Pl" ,10,0.5,4000,15332,5354,"Eskimo or Clown Nebula"},
//    { "Sb" ,11,3,86000000,23214,4697,""},
//    { "Oc" ,1,330,151,9113,4096,"Hyades"},
//    { "Gc" ,11,2.8,135000,43059,4142,""},
//    { "Sb" ,11,4,49000000,112,4134,""},
//    { "Sb" ,11,4,106000000,47271,3153,""},
//    { "Sp" ,10,5,74000000,27904,2274,""},
//    { "Bn" ,10,2,2500,13626,2235,"Hubble's Variable Nebula"},
//    { "Gc" ,9,5.9,57000,42127,1894,""},
//    { "Sp" ,10,4,55000000,18783,1800,""},
//    { "Bn" ,0,70,4900,13390,1292,"Rosette Nebula"},
//    { "Oc" ,5,24,4900,13393,1245,""},
//    { "Ir" ,9,11,2300000,2211,541,""},
//    { "El" ,9,4,76000000,26234,-1484,""},
//    { "El" ,9,5,22000000,20657,-1975,"Spindle Galaxy"},
//    { "Oc" ,8,7,10000,16390,-2760,""},
//    { "Pl" ,8,2,1400,43151,-2909,"Saturn Nebula"},
//    { "Pl" ,8,3.8,1600,1604,-3042,""},
//    { "Ir" ,9,9,2300000,40444,-3788,"Barnard's Galaxy"},
//    { "Oc" ,7,13,3700,14943,-3997,""},
//    { "Pl" ,9,0.5,1400,21326,-4770,"Ghost of Jupiter"},
//    { "Sp" ,11,2,83000000,24640,-4829,"Antennae Galaxies"},
//    { "Sp" ,13,2.5,83000000,24640,-4834,"Antennae Galaxies"},
//    { "Sp" ,9,15,6800000,1607,-5316,""},
//    { "Pl" ,7,13,522,46066,-5324,"Helix Nebula"},
//    { "Oc" ,4,8,5100,14977,-6387,""},
//    { "Sp" ,7,18,9800000,1624,-6472,"Sculptor Galaxy"},
//    { "Gc" ,10,3.6,113000,30023,-6792,""},
//    { "Sb" ,9,7,47000000,5676,-7752,""},
//    { "Bn" ,10,1,424,38976,-9459,""},
//    { "Pl" ,13,0.8,5200,35283,-9497,"Bug Nebula"},
//    { "Sp" ,8,16,3900000,1873,-9646,""},
//    { "Oc" ,6,27,3700,16121,-9868,""},
//    { "Sb" ,8,20,4200000,508,-10030,""},
//    { "Gc" ,7,11,39400,10721,-10252,""},
//    { "Pl" ,8,0.8,2000,20742,-10350,"Eight Burst Nebula"},
//    { "Oc" ,6,29,1500,33641,-10410,""},
//    { "Oc" ,3,15,6000,34611,-10700,""},
//    { "Px" ,7,16,16000000,27494,-11012,"Centaurus A"},
//    { "Gc" ,7,13,22300,37137,-11187,""},
//    { "Gc" ,7,18,17000,21080,-11882,""},
//    { "Gc" ,4,36,17300,27538,-12155,"Omega Centauri"},
//    { "Gc" ,8,7,18600,35686,-12394,""},
//    { "Oc" ,5,15,4300,34177,-12484,""},
//    { "Sp" ,10,6,17000000,26808,-12663,""},
//    { "Gc" ,8,9,36000,28207,-13149,""},
//    { "Oc" ,3,50,500,17756,-13585,"Omicron Vel Cluster"},
//    { "Gc" ,6,26,7500,36205,-13738,""},
//    { "Gc" ,8,7,55500,6563,-14135,""},
//    { "Oc" ,8,10,3400,30914,-14233,""},
//    { "Oc" ,5,12,3300,33413,-14822,"S Norma Cluster"},
//    { "Pl" ,10,0.2,5500,19162,-14929,""},
//    { "Oc" ,3,55,1600,22746,-15018,""},
//    { "Bn" ,6,120,7500,21975,-15325,"Eta Carinae Nebula"},
//    { "Gc" ,5,20,13000,39284,-15355,""},
//    { "Oc" ,4,10,4900,26405,-15445,"Jewel Box"},
//    { "Oc" ,5,12,2500,32894,-15488,""},
//    { "Oc" ,4,30,1300,16325,-15581,""},
//    { "Oc" ,5,12,5800,23760,-15773,""},
//    { "Oc" ,7,5,4200,26019,-16119,""},
//    { "Dn" ,0,300,610,26385,-16128,"Coalsack Nebula"},
//    { "Oc" ,5,15,6000,23777,-16136,"Lambda Centauri Nebula"},
//    { "Sb" ,9,13,34000000,39246,-16345,""},
//    { "Oc" ,2,50,492,21954,-16486,"Theta Car Cluster"},
//    { "Bn" ,1,30,170000,11560,-17689,"Tarantula Nebula"},
//    { "Gc" ,7,13,27700,2157,-18137,""},
//    { "Gc" ,7,14,19600,26610,-18146,""},
//    { "Gc" ,4,31,14700,822,-18453,"47 Tucanae"},
//    { "Gc" ,9,11,49900,33648,-18483,""},
//    { "Gc" ,8,19,18900,25456,-18602,""},
//    { "Pl" ,12,35,5400,20804,-20701,""}
//};
////char tpes[13][3]= {"As","Ba","Di","Ds","El","Gc","Ir","Ln","MW","Oc","Pl","Sn","Sp"}; // messier
//char tpes[12][3]= {"Bn","Dn","El","Gc","Ir","Oc","Pl","Px","Sb","Sn","Sp","Sx"}; // Caldwel



void to8float(int n, uint32_t &m, uint32_t &e)
{
    e= 0; while (n>100) { e++; n/=10; } m= n;
}
static void transformCatalog()
{
    QList<char*> strings;
    for (int i=0; i<109; i++)
    {
//        for (int j=0;j<12;j++) 
//            if (strcmp(cadwell[i].tpe, tpes[j])==0)
//            {
//                int sindex= 0;
//                uint32_t szeM, szee, dstM, dste;
//                to8float(cadwell[i].sze*10, szeM, szee);
//                to8float(cadwell[i].dst, dstM, dste);
//                if (strlen(cadwell[i].name)>0) { strings.append(cadwell[i].name); sindex= strings.count(); }
//                qDebug() << "  {" << cadwell[i].ra << ","<<cadwell[i].dec << ","<<j << ","<<cadwell[i].mag << ","<<szeM << ","<<szee << ","<<dstM << ","<<dste << ","<<sindex << "},";
//                break;
//            }
    }
    for (int i=0; i<strings.count(); i++)
        qDebug() << "   \""<<strings[i]<<"\",";
}

int main(int argc, char *argv[])
{
    if (argc==3) return startConvert(argv[1], argv[2]);
    QApplication a(argc, argv);
    MainWindow w;
    arduViseur= new CArduViseur;
    //generateStarPatern();
    Widget *native = new Widget(); native->setFixedWidth(screenW*screenZoom); native->setFixedHeight(screenH*screenZoom);
    w.layout()->addWidget(native);
    w.setWindowTitle("star viewer");
    w.show();
    return a.exec();
}

// generates the pattern for star display...
static uint8_t const starPics0[]=
{ 0, 6, 5, 5, 5, 6, 0,
  6, 5, 4, 4, 4, 5, 6,
  5, 4, 3, 2, 3, 4, 5,
  5, 4, 2, 1, 2, 4, 5,
  5, 4, 3, 2, 3, 4, 5,
  6, 5, 4, 4, 4, 5, 6,
  0, 6, 5, 5, 5, 6, 0,
};
static void generateStarPatern()
{
    int posandsize[32*2];
    int pos= 0;
    qDebug() << "static uint8_t const starPatternsV[]={";
    for (int i=0; i<32; i++)
    {
        int radii= 0;
        uint8_t p[7*7]= {0}; 
        int toSpread= (i+1)*31;
        for (int j=1; j<=6; j++) 
        {
            radii= j;
            int cnt= 0; for (int k=0; k<49;k++) if (starPics0[k]==j) cnt++;
            int val= (toSpread+cnt+1)/cnt; if (val>31) val= 31;
            for (int k=0; k<49;k++) if (starPics0[k]==j) p[k]= val, toSpread-= val;
            if (toSpread<=0) break;
        }
        if (radii==1) radii=0;
        else if (radii<=3) radii=1;
        else if (radii<=4) radii=2;
        else radii=3;
        posandsize[i*2]= pos; posandsize[i*2+1]= radii*2+1; 
        QString s= "  "; for (int y=3-radii; y<=3+radii; y++) for (int x=3-radii; x<=3+radii; x++) s+= QString::number(p[y*7+x])+",", pos++;
        qDebug() << s;
    }
    qDebug() << "};";
    qDebug() << "static struct { uint8_t const *p, size; } const starPatterns[32]={";
    for (int i=0; i<32; i++) qDebug() << "  { starPatternsV+"+QString::number(posandsize[(31-i)*2])+", "+QString::number(posandsize[(31-i)*2+1])+"},";
    qDebug() << "};";
}


#include <iostream>
#include <fstream>
#include <sstream>
#include <vector>
#include <algorithm>
#include <Qfile>

struct TTStar { float ra, dec, dist, mag, absmag; char name[30]; int con, bayer; bool more; };
static int sortF(TTStar const &s1, TTStar const &s2) { return s1.dec>s2.dec; }
static char *tok(char *&s, bool &eol, bool &eof)
{
    eol= eof= false;
    while (true) if (*s==0) { eol= eof= true; return nullptr; } else if (*s=='\n') { s++; eol= true; return nullptr; } else if (*s<=' ') *s++; else break;
    char *t= s;
    while (true) if (*s==',') { *s++= 0; return t; } else if (*s==0) { eol= eof= true; return nullptr; } else if (*s=='\n') { eol= true; *s++=0; return t; } else *s++; 
}

int startConvert(char const *inFile, char const *outFile)
{
    QFile f1(inFile); f1.open(QIODevice::ReadOnly); QByteArray d= f1.readAll(); f1.close();
    char *s= d.data();
    struct { char name[10]; int index; } cols[8]= {{"proper"},{"ra"},{"dec"},{"dist"},{"mag"},{"absmag"},{"bayer"},{"con"}};
    std::vector<TTStar> star;
    bool eol, eof;
    for (int i=0; i<8; i++) cols[i].index= -1;
    while (true)
    {
        char *t= tok(s, eol, eof); if (eof) exit(0); if (eol) break;
        for (int i=0; i<8; i++) if (strcmp(t, cols[i].name)==0) { cols[i].index= i; break; }
    }
    for (int i=0; i<8; i++) if (cols[i].index==-1) { printf("error in input file, first row does not include all collumns proper, ra, dec, dist, mag, absmag, bayer, con\r\n"); exit(0); }
    while (true)
    {
        TTStar st= {-1, -1, -1, -100, -100, "", -1, -1, false };
        int col= 0;
        while (true)
        {
            char *t= tok(s, eol, eof); if (eof||eol) break;
            for (int i=0; i<8; i++)
                if (cols[i].index==col)
                {
                    if (i>=1 && i<=5) // numbers
                    {
                        float res= strtof(t, nullptr);
                        if (i==1) st.ra= res; else if (i==2) st.dec= res; else if (i==3) st.dist= res; else if (i==4) st.mag= res; else st.absmag= res;
                        break;
                    }
                    else if (i==0) { strncpy_s(st.name, t, 30); st.name[15]=0; if (st.name[0]!=0) st.more= true; break; }
                    else if (i==6)
                    {
                        char const greek[24][4]= {{"Alp"},{"Bet"},{"Chi"},{"Del"},{"Eps"},{"Eta"},{"Gam"},{"Iot"},{"Kap"},{"Lam"},{"Mu"},{"Nu"},{"Ome"},{"Omi"},{"Phi"},{"Pi"},{"Psi"},{"Rho"},{"Sig"},{"Tau"},{"The"},{"Ups"},{"Xi"},{"Zet"}};
                        for (int j=0; j<24; j++) if (strcmp(greek[j], t)==0) { st.bayer= j; st.more= true; break;}
                        break;
                    }
                    else  if (i==7)
                    {
                        char const cons[88][4]= {{"And"},{"Ant"},{"Aps"},{"Aql"},{"Aqr"},{"Ara"},{"Ari"},{"Aur"},{"Boo"},{"CMa"},{"CMi"},{"CVn"},{"Cae"},{"Cam"},{"Cap"},{"Car"},{"Cas"},{"Cen"},{"Cep"},{"Cet"},{"Cha"},{"Cir"},{"Cnc"},{"Col"},{"Com"},{"CrA"},{"CrB"},{"Crt"},{"Cru"},{"Crv"},{"Cyg"},{"Del"},{"Dor"},{"Dra"},{"Equ"},{"Eri"},{"For"},{"Gem"},{"Gru"},{"Her"},{"Hor"},{"Hya"},{"Hyi"},{"Ind"},{"LMi"},{"Lac"},{"Leo"},{"Lep"},{"Lib"},{"Lup"},{"Lyn"},{"Lyr"},{"Men"},{"Mic"},{"Mon"},{"Mus"},{"Nor"},{"Oct"},{"Oph"},{"Ori"},{"Pav"},{"Peg"},{"Per"},{"Phe"},{"Pic"},{"PsA"},{"Psc"},{"Pup"},{"Pyx"},{"Ret"},{"Scl"},{"Sco"},{"Sct"},{"Ser"},{"Sex"},{"Sge"},{"Sgr"},{"Tau"},{"Tel"},{"TrA"},{"Tri"},{"Tuc"},{"UMa"},{"UMi"},{"Vel"},{"Vir"},{"Vol"},{"Vul"}};
                        for (int j=0; j<88; j++) if (strcmp(cons[j], t)==0) { st.con= j; break;}
                        break;
                    }
                }
            col++;
        }
        if (st.ra!=-1 && st.dec!=-1) star.push_back(st);
        if (eof) break;
    }

    std::sort (star.begin(), star.end(), sortF);

    QFile f2(outFile); f2.open(QIODevice::WriteOnly); 
    char buf[2000];

    char const ttstar[]="uint32_t const nbStars= %d; // = %dkb\r\nTStar const stars[]={\r\n";
    sprintf(buf, ttstar, star.size(), (star.size()*6)/1024);
    f2.write(buf);
    for (int i=0; i<star.size(); i++)
    {
        TStar st; st.setRa(star[i].ra); st.setDec(star[i].dec); st.setMag(star[i].mag); st.hasMoreInfo= star[i].more;
        uint8_t const *t= (uint8_t const *)&st;
        sprintf(buf, "  { %d, %d, %d, %d, %d, %d },\r\n", t[0], t[1], t[2], t[3], t[4], t[5]); f2.write(buf);
        f2.write(buf);
    }
    f2.write("};\r\nuint8_t const starsMore[]={\r\n");
    int nbmore= 0, moresize= 0;
    for (int i=0; i<star.size(); i++)
        if (star[i].more)
        {
            nbmore++;
            TStarMore sm; sm.name= strlen(star[i].name); sm.setIndex(i); sm.setBayerGreek(star[i].bayer), sm.setBayerConst(star[i].con), sm.setDist(star[i].dist); sm.setAbsMag(star[i].absmag);
            { uint8_t *t= (uint8_t*)&sm; sprintf(buf, "  %d, %d, %d, %d, %d, %d,", t[0], t[1], t[2], t[3], t[4], t[5]); f2.write(buf); }
            char t[1000];
            moresize+= 6+strlen(star[i].name);
            for (int j=0; j<strlen(star[i].name); j++) { t[j*4+0]= '\''; t[j*4+1]= star[i].name[j]; t[j*4+2]= '\''; t[j*4+3]= ','; }
            t[strlen(star[i].name)*4]= 0; strcat_s(t, "\r\n");
            f2.write(t);
        }
    sprintf(buf, "};\r\nuint32_t const nbMoreStars=%d; //%dbytes\r\n", nbmore, moresize); f2.write(buf);
    return 1;
}
